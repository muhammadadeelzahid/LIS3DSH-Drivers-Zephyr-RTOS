## drivers/sensor/Kconfig
```kconfig
# Copyright (c) 2021 Nordic Semiconductor ASA
# SPDX-License-Identifier: Apache-2.0

if SENSOR
rsource "lis3dsh/Kconfig"
endif # SENSOR
```

## drivers/sensor/lis3dsh/Kconfig
```kconfig
config LIS3DSH
	bool "LIS3DSH Three Axis Accelerometer"
	default y
	depends on DT_HAS_ST_LIS3DSH_ENABLED
	select SPI 
	help
	  Enable LIS3DSH sensor
```

## dts/bindings/sensor/st,lis3dsh.yaml
```yaml
# SPDX-License-Identifier: Apache-2.0

description: |
    STMicroelectronics LIS2DSH 3-axis accelerometer accessed through SPI bus

include: spi-device.yaml
compatible: "st,lis3dsh"
on-bus: spi
```
